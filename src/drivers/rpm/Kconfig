## src/drivers/rpm/Kconfig
```kconfig
menu "RPM sensors"
    menuconfig COMMON_DRIVERS_RPM
        bool "Common RPM Drivers"
        default n
        select DRIVERS_RPM_HOLYBRO_RPM
        ---help---
            Enable default set of RPM sensor drivers

    rsource "*/Kconfig"
endmenu
```

## src/drivers/rpm/holybro_rpm/Kconfig
```kconfig
menuconfig DRIVERS_RPM_HOLYBRO_RPM
	bool "holybro_rpm"
	default n
	---help---
		Enable support for holybro_rpm
```
